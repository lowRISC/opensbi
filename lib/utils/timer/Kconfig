## lib/utils/timer/Kconfig
```kconfig
# SPDX-License-Identifier: BSD-2-Clause

menu "Timer Device Support"

config FDT_TIMER
	bool "FDT based timer drivers"
	depends on FDT
	default n

if FDT_TIMER

config FDT_TIMER_LOWRISC_RVTIMER
	bool "lowRISC RV Timer FDT driver"
	select TIMER_LOWRISC_RVTIMER
	default n

config FDT_TIMER_MTIMER
	bool "ACLINT MTIMER FDT driver"
	select TIMER_MTIMER
	default n

config FDT_TIMER_PLMT
	bool "Andes PLMT FDT driver"
	select TIMER_PLMT
	default n

endif

config TIMER_LOWRISC_RVTIMER
	bool "lowRISC RV Timer support"
	default n

config TIMER_MTIMER
	bool "ACLINT MTIMER support"
	default n

config TIMER_PLMT
	bool "Andes PLMT support"
	default n

endmenu
```

## platform/generic/configs/mocha_defconfig
```kconfig
CONFIG_PLATFORM_ALLWINNER_D1=n
CONFIG_PLATFORM_ANDES_AE350=n
CONFIG_PLATFORM_RENESAS_RZFIVE=n
CONFIG_PLATFORM_SIFIVE_FU540=n
CONFIG_PLATFORM_SIFIVE_FU740=n
CONFIG_PLATFORM_SOPHGO_SG2042=n
CONFIG_PLATFORM_STARFIVE_JH7110=n
CONFIG_PLATFORM_THEAD=n
CONFIG_FDT_GPIO=n
CONFIG_FDT_GPIO_DESIGNWARE=n
CONFIG_FDT_GPIO_SIFIVE=n
CONFIG_FDT_GPIO_STARFIVE=n
CONFIG_FDT_I2C=n
CONFIG_FDT_I2C_SIFIVE=n
CONFIG_FDT_I2C_DW=n
CONFIG_FDT_IPI=y
CONFIG_FDT_IPI_MSWI=n
CONFIG_FDT_IPI_PLICSW=n
CONFIG_FDT_IPI_LOWRISC_PLICSW=y
CONFIG_FDT_IRQCHIP=y
CONFIG_FDT_IRQCHIP_APLIC=n
CONFIG_FDT_IRQCHIP_IMSIC=n
CONFIG_FDT_IRQCHIP_PLIC=y
CONFIG_FDT_REGMAP=n
CONFIG_FDT_REGMAP_SYSCON=n
CONFIG_FDT_RESET=n
CONFIG_FDT_RESET_ATCWDT200=n
CONFIG_FDT_RESET_GPIO=n
CONFIG_FDT_RESET_HTIF=n
CONFIG_FDT_RESET_SUNXI_WDT=n
CONFIG_FDT_RESET_SG2042_HWMON_MCU=n
CONFIG_FDT_RESET_SYSCON=n
CONFIG_FDT_SERIAL=y
CONFIG_FDT_SERIAL_CADENCE=n
CONFIG_FDT_SERIAL_GAISLER=n
CONFIG_FDT_SERIAL_HTIF=n
CONFIG_FDT_SERIAL_RENESAS_SCIF=n
CONFIG_FDT_SERIAL_SHAKTI=n
CONFIG_FDT_SERIAL_SIFIVE=n
CONFIG_FDT_SERIAL_LITEX=n
CONFIG_FDT_SERIAL_LOWRISC_OPENTITAN=y
CONFIG_FDT_SERIAL_UART8250=n
CONFIG_FDT_SERIAL_XILINX_UARTLITE=n
CONFIG_SERIAL_SEMIHOSTING=n
CONFIG_FDT_TIMER=y
CONFIG_FDT_TIMER_LOWRISC_RVTIMER=y
CONFIG_FDT_TIMER_MTIMER=n
CONFIG_FDT_TIMER_PLMT=n
```
